# N32H7xx register map
Vendor: Nationstech Ltd.; File version: 1.0
CPU: CM7 r1p1, little endian, MPU, FPU, 4 interrupt priority bits
Registers are 32-bit, read-write, reset 0x0 unless marked. A register's access mark holds for its fields unless they carry their own. Offsets are from the block's base; lines under a group give offsets from that group; [hi:lo] are bit positions; {n}, {i} and the like mark numbered series; 'fields as' and 'values as' point back to an identical list; <NAME> marks a mode.

## Memory map
0x40000000 FDCAN1 size 0x400 — Flexible Datarate Controller Area Network
0x40000400 FDCAN2 size 0x400
0x40000800 FDCAN5 size 0x400
0x40000C00 FDCAN6 size 0x400
0x4000A000 BTIM1 size 0x400 — Basic timer
0x4000A400 BTIM2 size 0x400
0x4000A800 GTIMB1 size 0x400 — General purpose timer B
0x4000AC00 GTIMB2 size 0x400
0x4000B000 GTIMB3 size 0x400
0x4000B400 GTIMA4 size 0x400
0x4000B800 GTIMA5 size 0x400
0x4000BC00 GTIMA6 size 0x400
0x4000C000 GTIMA7 size 0x400
0x4000C400 USART1 size 0x400
0x4000C800 USART2 size 0x400
0x4000CC00 USART3 size 0x400
0x4000D000 USART4 size 0x400
0x4000D400 UART9 size 0x400
0x4000D800 UART10 size 0x400
0x4000DC00 UART11 size 0x400
0x4000E000 UART12 size 0x400
0x4000E400 SPI3 size 0x400
0x4000E800 I2C1 size 0x400 — Inter-Integrated Circuit interface
0x4000EC00 I2C2 size 0x400
0x4000F000 I2C3 size 0x400
0x4000F400 I2S3 size 0x200
0x4000F600 I2S3_EXT size 0x200
0x4000F800 I2S4 size 0x200
0x4000FA00 I2S4_EXT size 0x200
0x4000FC00 DAC12 size 0x400
0x40010000 WWDG2 size 0x400
0x40010800 BTIM3 size 0x400
0x40010C00 BTIM4 size 0x400
0x40042000 ETH2 size 0x2000 — Ethernet 2
0x40044000 ADC1 size 0x400 — Analog to digital converter
0x40044400 ADC2 size 0x400
0x40044800 ADC3 size 0x400
0x40045000 AHB_CACHE_PARMON size 0x1000 — AHB cache parity monitor
0x40046400 DMAMUX1 size 0x400 — DMA request multiplexer
0x40046800 DMA1 size 0x400 — DMA controller 1
0x40046C00 DMA2 size 0x400 — DMA controller 2
0x40047000 DMA3 size 0x400 — DMA controller 3
0x4004A000 SDMMC2 size 0x400
0x40050000 SDHOST2 size 0x100
0x40060000 USB_HS2_Global size 0x400 — USB high speed dual role 2
0x40060400 USB_HS2_HOST size 0x400
0x40060800 USB_HS2_DEVICE size 0x600
0x40060E00 USB_HS2_PWRCLK size 0x400
0x400A0000 USB_HS2_WRP size 0x400
0x400D0000 FDCAN3 size 0x400
0x400D0400 FDCAN4 size 0x400
0x400D0800 FDCAN7 size 0x400
0x400D0C00 FDCAN8 size 0x400
0x400D8000 SHRTIM1_Master size 0x80 — Super high resolution timer: Master Timers
0x400D8080 SHRTIM1_TIMA size 0x80 — Super high resolution timer: TIMA
0x400D8100 SHRTIM1_TIMB size 0x80 — Super high resolution timer: TIMB
0x400D8180 SHRTIM1_TIMC size 0x80 — Super high resolution timer: TIMC
0x400D8200 SHRTIM1_TIMD size 0x80 — Super high resolution timer: TIMD
0x400D8280 SHRTIM1_TIME size 0x80 — Super high resolution timer: TIME
0x400D8300 SHRTIM1_TIMF size 0x80 — Super high resolution timer: TIMF
0x400D8380 SHRTIM1_Common size 0x400 — Super high resolution timer: Common functions
0x400D9000 SHRTIM2_Master size 0x80 — Super high resolution timer: Master Timers
0x400D9080 SHRTIM2_TIMA size 0x80 — Super high resolution timer: TIMA
0x400D9100 SHRTIM2_TIMB size 0x80 — Super high resolution timer: TIMB
0x400D9180 SHRTIM2_TIMC size 0x80 — Super high resolution timer: TIMC
0x400D9200 SHRTIM2_TIMD size 0x80 — Super high resolution timer: TIMD
0x400D9280 SHRTIM2_TIME size 0x80 — Super high resolution timer: TIME
0x400D9300 SHRTIM2_TIMF size 0x80 — Super high resolution timer: TIMF
0x400D9380 SHRTIM2_Common size 0x400 — Super high resolution timer: Common functions
0x400DA000 DSMU size 0x1000 — Digital filter and sigma delta modulators
0x400DB000 ATIM1 size 0x400 — Advanced timer
0x400DB400 ATIM2 size 0x400
0x400DB800 I2S1 size 0x200 — Inter—IC Sound
0x400DBA00 I2S1_EXT size 0x200 — Inter—IC Sound
0x400DBC00 I2S2 size 0x200
0x400DBE00 I2S2_EXT size 0x200
0x400DC000 SPI1 size 0x400 — Serial peripheral interface
0x400DC400 SPI2 size 0x400
0x400DC800 GTIMA1 size 0x400 — General purpose timer A
0x400DCC00 GTIMA2 size 0x400
0x400DD000 GTIMA3 size 0x400
0x400DD400 I2C4 size 0x400
0x400DD800 I2C5 size 0x400
0x400DDC00 I2C6 size 0x400
0x400DE000 USART5 size 0x400
0x400DE400 USART6 size 0x400
0x400DE800 USART7 size 0x400
0x400DEC00 USART8 size 0x400
0x400DF000 UART13 size 0x400
0x400DF400 UART14 size 0x400
0x400DF800 UART15 size 0x400
0x400F0000 ECCMON2 size 0x1000 — ECC Monitoring
0x400F1000 CORDIC size 0x400 — CORDIC Processors
0x400F1400 FMAC size 0x400 — Filter math accelerator
0x400F1800 DAC34 size 0x400
0x400F1C00 DAC56 size 0x400
0x400F4000 ETH1 size 0x2000 — Ethernet 1
0x400F7000 DCMUA size 0x1000 — DCMU processor A side
0x400F8000 DCMUB size 0x1000 — DCMU processor B side
0x40100000 USB_HS1_Global size 0x400 — USB high speed dual role 1
0x40100400 USB_HS1_HOST size 0x400 — USB high speed host mode 1
0x40100800 USB_HS1_DEVICE size 0x600 — USB high speed device mode 1
0x40100E00 USB_HS1_PWRCLK size 0x400 — USB high speed PWR clock control 1
0x40140000 USB_HS1_WRP size 0x400 — USB high speed Wrapper control
0x50000000 DSI_HOST size 0x40000 — DSI Host Controller registers
0x50040000 GPU size 0x4000 — Graphics processing unit
0x50048000 DVP1 size 0x1000 — Digital video port
0x50049000 DVP2 size 0x1000
0x5004A000 LCDC size 0x800
0x5004A800 WWDG1 size 0x400 — window watchdog
0x5004AC00 DSI_HOST_WRAPPER size 0x400 — DSI wrapper registers
0x5004B000 TCMC size 0x1000 — Tightly Coupled Memory Controller
0x5004C000 FEMC size 0x1000 — Flexible external memory controller
0x50060000 ENC size 0x10000 — Host to peripherals
0x50070000 RBC size 0x400 — Host to peripherals
0x50070400 H2P size 0x400 — Host to peripherals
0x50080000 DEC size 0x800 — peripherals to Host
0x50090000 BRC size 0x400 — peripherals to Host
0x50090400 P2H size 0x400 — peripherals to Host
0x50090800 JPEGCTRL size 0x800 — JPEG mode CTRL
0x51000000 GPV size 0x100000 — Global programmer view
0x51100000 xSPI1 size 0x1000 — Multi-line SPI
0x51101000 xSPI2 size 0x1000
0x51102000 MDMA size 0x2000 — MDMA controller
0x51104000 ECCMON1P1 size 0x400 — ECC Monitoring
0x51104400 ECCMON1P2 size 0x400 — ECC Monitoring
0x51104800 ECCMON1P3 size 0x400 — ECC Monitoring
0x51104C00 ECCMON1P4 size 0x400 — ECC Monitoring
0x51105000 MMU size 0x400 — Memory Manage Unit
0x51106000 SDRAM size 0x1000 — Synchronous dynamic random access memory controller
0x51107000 SDMMC1 size 0x400 — Secure Digital MultiMedia Card
0x51110000 SDHOST1 size 0x100 — Secure Digital MultiMedia Card
0x51118000 OTPC size 0x4000 — One Time Programble Controller
0x51120000 DMAMUX2 size 0x800 — DMA request multiplexer
0x58000000 EXTI size 0x400 — The Extended Interrupt and Event Controller
0x58000800 LPUART1 size 0x400 — Low-power universal asynchronous receiver transmitter
0x58000C00 LPUART2 size 0x400
0x58001000 LPTIM1 size 0x400 — Low Power Timer
0x58001400 LPTIM2 size 0x400
0x58001800 LPTIM3 size 0x400
0x58001C00 LPTIM4 size 0x400
0x58002000 SPI4 size 0x400
0x58002400 SPI5 size 0x400
0x58002800 SPI6 size 0x400
0x58002C00 SPI7 size 0x400
0x58003000 I2C7 size 0x400
0x58003400 I2C8 size 0x400
0x58003800 I2C9 size 0x400
0x58003C00 I2C10 size 0x400
0x58004000 ATIM3 size 0x400
0x58004400 ATIM4 size 0x400
0x58004800 COMP size 0x400
0x58004C00 IWDG1 size 0x400 — Independent watchdog
0x58005000 IWDG2 size 0x400
0x58005400 RTC size 0x400 — Real time clock
0x58005800 LPTIM5 size 0x400
0x58030000 RCC size 0x1000 — Reset and clock control
0x58031000 PWR size 0x1000 — Power Control
0x58032000 CRC size 0x400 — Cyclic Redundancy Check
0x58032400 AFIO size 0x400 — Alternate Function I/O
0x58032800 GPIOA size 0x400 — Genera Purpose I/O
0x58032C00 GPIOB size 0x400
0x58033000 GPIOC size 0x400
0x58033400 GPIOD size 0x400
0x58033800 GPIOE size 0x400
0x58033C00 GPIOF size 0x400
0x58034000 GPIOG size 0x400
0x58034400 GPIOH size 0x400
0x58034800 GPIOI size 0x400
0x58034C00 GPIOJ size 0x400
0x58035000 GPIOK size 0x400
0x58035400 DBG size 0x400 — Debug
0x58036000 ECCMON3 size 0x1000 — ECC Monitoring

## Interrupts
0 WWDG1 — WWDG1 interrupt
1 PVD (PWR) — PVD through EXTI line 16
2 RTC_TAMPER (RTC) — RTC tamper, timestamp or CSS LSE or RTC OVERFLOW or LSICSS through EXTI line 18
3 RTC_WKUP (RTC) — RTC Wakeup interrupt through EXTI line 19
4 RCC — RCC global interrupt
5 EXTI0 (EXTI) — EXTI Line 0 interrupt
6 EXTI1 (EXTI) — EXTI Line 1 interrupt
7 EXTI2 (EXTI) — EXTI Line 2 interrupt
8 EXTI3 (EXTI) — EXTI Line 3 interrupt
9 EXTI4 (EXTI) — EXTI Line 4 interrupt
10 EXTI9_5 (EXTI) — EXTI Line[9:5] interrupt
11 EXTI15_10 (EXTI) — EXTI Line[15:10] interrupt
{n+12} DMA1_channel_{n} (DMA1) (n=0..7) — DMA1 channel {n} global interrupt
{n+20} DMA2_Channel_{n}_IRQ (DMA2) (n=0..7) — DMA2 Channel {n} global interrupt
{n+28} DMA3_Channel_{n}_IRQ (DMA3) (n=0..7) — DMA3 Channel {n} global interrupt
{n+36} MDMA_channel_{n} (MDMA) (n=0..15) — MDMA channel {n} global interrupt
56 ECCMON (ECCMON1P1) — ECCMON global interrupt
57 RTC_ALARM (RTC) — RTC Alarm through EXTI line 17
{2n+56} I2C{n}_EVENT (I2C{n}) (n=1..10) — I2C{n} Event interrupt
{2n+57} I2C{n}_ERR (I2C{n}) (n=1..10) — I2C{n} error interrupt
78 I2S1 — I2S1/I2S1_EXT global interrupt
79 I2S2 — I2S2/I2S2_EXT global interrupt
80 I2S3 — I2S3/I2S3_EXT global interrupt
81 I2S4 — I2S4/I2S4_EXT global interrupt
82 xSPI1 — xSPI1 global interrupt
83 xSPI2 — xSPI2 global interrupt
84 SPI1 — SPI1 global interrupt
85 SPI2 — SPI2 global interrupt
86 SPI3 — SPI3 global interrupt
87 SPI4 — SPI4 global interrupt
88 SPI5 — SPI5 global interrupt
89 SPI6 — SPI6 global interrupt
90 SPI7 — SPI7 global interrupt
91 LCD_EVENT (LCDC) — TFT LCD Controller event interrupt
92 LCD_ERR (LCDC) — TFT LCD Controller error interrupt
93 DVP1 — DVP1 global interrupt
94 DVP2 — DVP1 global interrupt
95 DMAMUX2 — DMAMUX2 (MDMA MUX) global interrupt
96 USBHS1_HS_EPx_OUT (USB_HS1_Global) — USBHS1_HS endpoint out global interrupt
97 USBHS1_HS_EPx_IN (USB_HS1_Global) — USBHS1_HS endpoint in global interrupt
98 USBHS1_HS_WKUP (USB_HS1_Global) — USBHS1_HS WKUP interrupt through EXTI line 62
99 USBHS1_HS (USB_HS1_Global) — USBHS1_HS global interrupt
100 USBHS2_HS_EPx_OUT (USB_HS2_Global) — USBHS2_HS endpoint out global interrupt
101 USBHS2_HS_EPx_IN (USB_HS2_Global) — USBHS2_HS endpoint in global interrupt
102 USBHS2_HS_WKUP (USB_HS2_Global) — USBHS2_HS WKUP interrupt through EXTI line 63
103 USBHS2_HS (USB_HS2_Global) — USBHS2_HS global interrupt
104 ETH1 — Ethernet 1 global interrupt
105 ETH1_PMT_LPI (ETH1) — Ethernet 1 PMT wakeup interrupt and LPI interrupt through EXTI line 83
106 ETH2 — Ethernet 2 global interrupt
107 ETH2_PMT_LPI (ETH2) — Ethernet 2 PMT wakeup interrupt and LPI interrupt through EXTI line 84
108 FDCAN1_INT0 (FDCAN1) — FDCAN1 global interrupt line 0
109 FDCAN2_INT0 (FDCAN2) — FDCAN2 global interrupt line 0
110 FDCAN3_INT0 (FDCAN3) — FDCAN3 global interrupt line 0
111 FDCAN4_INT0 (FDCAN4) — FDCAN4 global interrupt line 0
112 FDCAN1_INT1 (FDCAN1) — FDCAN1 global interrupt line 1
113 FDCAN2_INT1 (FDCAN2) — FDCAN2 global interrupt line 1
114 FDCAN3_INT1 (FDCAN3) — FDCAN3 global interrupt line 1
115 FDCAN4_INT1 (FDCAN4) — FDCAN4 global interrupt line 1
{n+115} USART{n} (n=1..8) — USART{n} global interrupt
124 UART9 — UART9 global interrupt
125 UART10 — UART10 global interrupt
126 UART11 — UART11 global interrupt
127 UART12 — UART12 global interrupt
128 UART13 — UART13 global interrupt
129 UART14 — UART14 global interrupt
130 UART15 — UART15 global interrupt
131 LPUART1 — LPUART1 global interrupt + wakeup through EXTI line 49
132 LPUART2 — LPUART2 global interrupt + wakeup through EXTI line 52
133 GPU — GPU global interrupt
135 SDMMC1 — SDMMC1_IRQ + WKUP through EXTI line 24
136 SDMMC2 — SDMMC2_IRQ + WKUP through EXTI line 25
137 ADC1 — ADC1 global interrupt
138 ADC2 — ADC2 global interrupt
139 ADC3 — ADC3 global interrupt
140 COMP12 (COMP) — COMP1 and COMP2 through EXTI line 20 and 21
141 COMP34 (COMP) — COMP3 and COMP4 through EXTI line 22 and 23
142 SHRTIM1_INT1 (SHRTIM1_Master) — SHRTIM_Master global interrupt
143 SHRTIM1_INT2 (SHRTIM1_TIMA) — SHRTIM_TIMA global interrupt
144 SHRTIM1_INT3 (SHRTIM1_TIMB) — SHRTIM_TIMB global interrupt
145 SHRTIM1_INT4 (SHRTIM1_TIMC) — SHRTIM_TIMC global interrupt
146 SHRTIM1_INT5 (SHRTIM1_TIMD) — SHRTIM_TIMD global interrupt
147 SHRTIM1_INT6 (SHRTIM1_TIME) — SHRTIM_TIME global interrupt
148 SHRTIM1_INT7 (SHRTIM1_TIMF) — SHRTIM_TIMF global interrupt
149 SHRTIM1_INT8 (SHRTIM1_Common) — SHRTIM_Common global interrupt
150 SHRTIM2_INT1 (SHRTIM2_Master) — SHRTIM_Master global interrupt
151 SHRTIM2_INT2 (SHRTIM2_TIMA) — SHRTIM_TIMA global interrupt
152 SHRTIM2_INT3 (SHRTIM2_TIMB) — SHRTIM_TIMB global interrupt
153 SHRTIM2_INT4 (SHRTIM2_TIMC) — SHRTIM_TIMC global interrupt
154 SHRTIM2_INT5 (SHRTIM2_TIMD) — SHRTIM_TIMD global interrupt
155 SHRTIM2_INT6 (SHRTIM2_TIME) — SHRTIM_TIME global interrupt
156 SHRTIM2_INT7 (SHRTIM2_TIMF) — SHRTIM_TIMF global interrupt
157 SHRTIM2_INT8 (SHRTIM2_Common) — SHRTIM_Common global interrupt
158 FDCAN5_INT0 (FDCAN5) — FDCAN5 global interrupt line 0
159 FDCAN6_INT0 (FDCAN6) — FDCAN6 global interrupt line 0
160 FDCAN7_INT0 (FDCAN7) — FDCAN7 global interrupt line 0
161 FDCAN8_INT0 (FDCAN8) — FDCAN8 global interrupt line 0
162 FDCAN5_INT1 (FDCAN5) — FDCAN5 global interrupt line 1
163 FDCAN6_INT1 (FDCAN6) — FDCAN6 global interrupt line 1
164 FDCAN7_INT1 (FDCAN7) — FDCAN7 global interrupt line 1
165 FDCAN8_INT1 (FDCAN8) — FDCAN8 global interrupt line 1
166 DSI (DSI_HOST) — MIPI DSI Interrupt through EXTI line 87
168 LPTIM5_wakeup (LPTIM5) — LPTIM5 global interrupt through EXTI line 86
169 JPEG_SGDMA_H2P (H2P) — JPEG SGDMA Host to Peripheral Interrupt
170 JPEG_SGDMA_P2H (P2H) — JPEG SGDMA Peripheral to Host Interrupt
174 WWDG1_RST (WWDG1) — WWDG1 reset interrupt through EXTI line 81
175 OTPC — OTPC global interrupt
176 FEMC — FEMC interrupt
177 DCMUB — DCMUB interrupt
178 DAC1 (DAC12) — DAC1 IRQ
179 DAC2 (DAC12) — DAC2 IRQ
180 MDMA_AHBS_ER (MDMA) — MDMA AHBS ERROR through EXTI line 55-56
182 DAC3 (DAC34) — DAC3 interrupt
183 DAC4 (DAC34) — DAC4 interrupt
185 DAC5 (DAC56) — DAC5 interrupt
186 DAC6 (DAC56) — DAC6 interrupt
192 ATIM1_BRK (ATIM1) — ATIM1 break interrupt
193 ATIM1_TRG_COM (ATIM1) — ATIM1 trigger and commutation Interrupt
194 ATIM1_CC (ATIM1) — ATIM1 capture compare interrupt
195 ATIM1_UP (ATIM1) — ATIM1 update interrupt
196 ATIM2_BRK (ATIM2) — ATIM2 break interrupt
197 ATIM2_TRG_COM (ATIM2) — ATIM2 trigger and commutation Interrupt
198 ATIM2_CC (ATIM2) — ATIM2 capture compare interrupt
199 ATIM2_UP (ATIM2) — ATIM2 update interrupt
200 ATIM3_BRK (ATIM3) — ATIM3 break interrupt
201 ATIM3_TRG_COM (ATIM3) — ATIM3 trigger and commutation Interrupt
202 ATIM3_CC (ATIM3) — ATIM3 capture compare interrupt
203 ATIM3_UP (ATIM3) — ATIM3 update interrupt
204 ATIM4_BRK (ATIM4) — ATIM4 break interrupt
205 ATIM4_TRG_COM (ATIM4) — ATIM4 trigger and commutation Interrupt
206 ATIM4_CC (ATIM4) — ATIM4 capture compare interrupt
207 ATIM4_UP (ATIM4) — ATIM4 update interrupt
208 GTIMA1 — GTIMA1 global interrupt
209 GTIMA2 — GTIMA2 global interrupt
210 GTIMA3 — GTIMA3 global interrupt
211 GTIMA4 — GTIMA4 global interrupt
212 GTIMA5 — GTIMA5 global interrupt
213 GTIMA6 — GTIMA6 global interrupt
214 GTIMA7 — GTIMA7 global interrupt
215 GTIMB1 — GTIMB1 global interrupt
216 GTIMB2 — GTIMB2 global interrupt
217 GTIMB3 — GTIMB3 global interrupt
218 BTIM1 — BTIM1 global interrupt
219 BTIM2 — BTIM2 global interrupt
220 BTIM3 — BTIM3 global interrupt
221 BTIM4 — BTIM4 global interrupt
222 LPTIM1_wakeup (LPTIM1) — LPTIM1 global interrupt through EXTI line 66
223 LPTIM2_wakeup (LPTIM2) — LPTIM2 global interrupt through EXTI line 67
224 LPTIM3_wakeup (LPTIM3) — LPTIM3 global interrupt through EXTI line 68
225 LPTIM4_wakeup (LPTIM4) — LPTIM4 global interrupt through EXTI line 69
226 DSMU_FLT0 (DSMU) — DSMU Filter Interrupt 0
227 DSMU_FLT1 (DSMU) — DSMU Filter Interrupt 1
228 DSMU_FLT2 (DSMU) — DSMU Filter Interrupt 2
229 DSMU_FLT3 (DSMU) — DSMU Filter Interrupt 3
230 FMAC — FMAC global interrupt
231 CORDIC — Cordic global interrupt
232 DMAMUX1 — DMAMUX1 interrupt
233 MMU — MMU interrupt
